&xiao_i2c {
    status = "okay";
    trackpad: cirque@2a {
        compatible = "cirque,pinnacle";
        reg = <0x2a>;
        status = "okay";
        dr-gpios = <&xiao_d 2 (GPIO_ACTIVE_HIGH)>; // 割り込みピン
    };
};
