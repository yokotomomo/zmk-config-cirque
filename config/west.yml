## config/west.yml
```yaml
manifest:
  remotes:
    - name: zmkfirmware
      url-base: https://github.com/zmkfirmware
    # --- ここから追加 ---
    - name: caksoylar
      url-base: https://github.com/caksoylar
    # --- ここまで追加 ---
  projects:
    - name: zmk
      remote: zmkfirmware
      revision: main
      import: app/west.yml
    # --- ここから追加 ---
    - name: zmk-rgbled-widget
      remote: caksoylar
      revision: main
    # --- ここまで追加 ---
  self:
    path: config
```
