#include <behaviors.dtsi>
#include <dt-bindings/zmk/keys.h>
#include <dt-bindings/zmk/bt.h>
#include <dt-bindings/zmk/mouse.h>

/ {
    /* トラックパッドの入力をOSにマウスとして伝える設定 */
    trackpad_listener {
        compatible = "zmk,input-listener";
        device = <&trackpad>;
    };

    keymap {
        compatible = "zmk,keymap";
        default_layer {
            bindings = <
                /* 動作確認用に1ボタンのみ設定 */
                &kp A
            >;
        };
    };
};
